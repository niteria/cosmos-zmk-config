## Kconfig
```kconfig
config COSMOS_UNLOCK
    bool "Cosmos private USB unlock chord"
    depends on ZMK_USB && ZMK_SPLIT_ROLE_CENTRAL
    depends on ZMK_USB_BOOT
    depends on SETTINGS && SETTINGS_NVS
    help
      Load the unlock credential from persistent settings. A one-time,
      post-build provisioning command installs it; ordinary public firmware
      updates retain it. Physical Func+J+K+L held for two seconds types it.

config COSMOS_SCROLL_LATCH
    bool "Cosmos latched trackball scrolling"
    depends on ZMK_POINTING && ZMK_SPLIT_ROLE_CENTRAL
    help
      Raise+H latches trackball scrolling until the next physical keyboard-key
      or mouse-button press. Holding Raise still enables momentary scrolling.
```

## config/west.yml
```yaml
manifest:
  defaults:
    revision: v0.3
  remotes:
    - name: zmkfirmware
      url-base: https://github.com/zmkfirmware
    - name: badjeff
      url-base: https://github.com/badjeff
  projects:
    - name: zmk
      remote: zmkfirmware
      import: app/west.yml
    - name: zmk-pmw3610-driver
      remote: badjeff
      # Tested ZMK v0.3-compatible revision (upstream branch: zmk-0.3).
      revision: 5c5af40de4d8cdf55dc63c4c5907af1e52da6a95
      path: modules/pmw3610
  self:
    path: config
```

## dts/bindings/behaviors/cosmos,scroll-latch.yaml
```yaml
description: Latch trackball scrolling until the next physical key or mouse-button press
compatible: "cosmos,scroll-latch"
include: zero_param.yaml
```

## dts/bindings/behaviors/cosmos,unlock.yaml
```yaml
description: Private USB-only Cosmos unlock chord
compatible: "cosmos,unlock"
include: zero_param.yaml
```

## dts/bindings/input_processors/cosmos,input-processor-scroll.yaml
```yaml
description: Momentary or latched Cosmos trackball scrolling and button cancellation
compatible: "cosmos,input-processor-scroll"
include: ip_zero_param.yaml

properties:
  raise-layer:
    type: int
    required: true
    description: Keyboard layer that enables momentary scrolling
  scroll-divisor:
    type: int
    required: true
    description: Divide trackball deltas by this value, preserving fractional motion
```
