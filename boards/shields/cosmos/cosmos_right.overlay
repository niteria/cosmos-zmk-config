#include "cosmos.dtsi"

&default_transform {
    col-offset = <6>;
};

&kscan0 {
    // Columns for right half (cols 6-11) - reversed order to match physical wiring
    col-gpios = <&gpio0 22 (GPIO_ACTIVE_HIGH | GPIO_PULL_DOWN)>,
                <&gpio0 24 (GPIO_ACTIVE_HIGH | GPIO_PULL_DOWN)>,
                <&gpio1 0 (GPIO_ACTIVE_HIGH | GPIO_PULL_DOWN)>,
                <&gpio0 11 (GPIO_ACTIVE_HIGH | GPIO_PULL_DOWN)>,
                <&gpio1 4 (GPIO_ACTIVE_HIGH | GPIO_PULL_DOWN)>,
                <&gpio1 6 (GPIO_ACTIVE_HIGH | GPIO_PULL_DOWN)>;
};
