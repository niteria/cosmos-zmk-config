## boards/shields/cosmos/Kconfig.defconfig
```kconfig
if SHIELD_COSMOS

config ZMK_KEYBOARD_NAME
    string
    default "Cosmos"

config ZMK_SPLIT
    bool
    default y

config ZMK_SPLIT_BLE
    bool
    default y

# Pointing device support
config ZMK_POINTING
    bool
    default y

config ZMK_SPLIT_POINTING_ENABLE
    bool
    default y

config SPI
    bool
    default y

config INPUT
    bool
    default y

config SENSOR
    bool
    default y

# PMW3360/PMW3389 trackball driver
config INPUT_PIXART_PMW3360
    bool
    default y

# Split role is determined by which shield is used
# cosmos_right is central, cosmos_left is peripheral

endif

if SHIELD_COSMOS_RIGHT

config ZMK_SPLIT_ROLE_CENTRAL
    bool
    default y

# Number of peripherals (just the left half)
config ZMK_SPLIT_BLE_CENTRAL_PERIPHERALS
    int
    default 1

# BT_MAX_CONN = peripherals + 5 (default BT profiles)
config BT_MAX_CONN
    int
    default 6

config BT_MAX_PAIRED
    int
    default 6

endif
```

## boards/shields/cosmos/Kconfig.shield
```kconfig
config SHIELD_COSMOS_LEFT
    def_bool $(shields_list_contains,cosmos_left)

config SHIELD_COSMOS_RIGHT
    def_bool $(shields_list_contains,cosmos_right)

config SHIELD_COSMOS
    def_bool $(shields_list_contains,cosmos_left) || $(shields_list_contains,cosmos_right)
```
